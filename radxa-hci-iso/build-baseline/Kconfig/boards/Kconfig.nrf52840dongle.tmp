## radxa-hci-iso/build-baseline/Kconfig/boards/Kconfig.nrf52840dongle.tmp
```kconfig
# Load board Kconfig descriptions.
osource "/home/bbspr/nrf-hci-iso/zephyrproject/zephyr/boards/nordic/nrf52840dongle/Kconfig.nrf52840dongle"
```

## radxa-hci-iso/build-baseline/Kconfig/boards/Kconfig.sysbuild
```kconfig
# Load Sysbuild board Kconfig descriptions.
osource "/home/bbspr/nrf-hci-iso/zephyrproject/zephyr/boards/nordic/nrf52840dongle/Kconfig.sysbuild"
```

## radxa-hci-iso/build-lean/Kconfig/Kconfig.modules
```kconfig
menu "cmsis (/home/bbspr/nrf-hci-iso/zephyrproject/modules/hal/cmsis)"
osource "$(ZEPHYR_CMSIS_KCONFIG)"
config ZEPHYR_CMSIS_MODULE
	bool
	default y
endmenu
menu "cmsis_6 (/home/bbspr/nrf-hci-iso/zephyrproject/modules/hal/cmsis_6)"
osource "$(ZEPHYR_CMSIS_6_KCONFIG)"
config ZEPHYR_CMSIS_6_MODULE
	bool
	default y
endmenu
menu "hal_nordic (/home/bbspr/nrf-hci-iso/zephyrproject/modules/hal/nordic)"
osource "$(ZEPHYR_HAL_NORDIC_KCONFIG)"
config ZEPHYR_HAL_NORDIC_MODULE
	bool
	default y

config ZEPHYR_HAL_NORDIC_MODULE_BLOBS
	bool
endmenu
menu "mbedtls (/home/bbspr/nrf-hci-iso/zephyrproject/modules/crypto/mbedtls)"
osource "$(ZEPHYR_MBEDTLS_KCONFIG)"
config ZEPHYR_MBEDTLS_MODULE
	bool
	default y
endmenu
config ZEPHYR_TF_PSA_CRYPTO_MODULE
	bool
	default y
```

## radxa-hci-iso/build-lean/Kconfig/arch/Kconfig
```kconfig
# Load Zephyr Arch Kconfig descriptions.
osource "/home/bbspr/nrf-hci-iso/zephyrproject/zephyr/arch/rx/Kconfig"
osource "/home/bbspr/nrf-hci-iso/zephyrproject/zephyr/arch/x86/Kconfig"
osource "/home/bbspr/nrf-hci-iso/zephyrproject/zephyr/arch/xtensa/Kconfig"
osource "/home/bbspr/nrf-hci-iso/zephyrproject/zephyr/arch/sparc/Kconfig"
osource "/home/bbspr/nrf-hci-iso/zephyrproject/zephyr/arch/riscv/Kconfig"
osource "/home/bbspr/nrf-hci-iso/zephyrproject/zephyr/arch/posix/Kconfig"
osource "/home/bbspr/nrf-hci-iso/zephyrproject/zephyr/arch/openrisc/Kconfig"
osource "/home/bbspr/nrf-hci-iso/zephyrproject/zephyr/arch/mips/Kconfig"
osource "/home/bbspr/nrf-hci-iso/zephyrproject/zephyr/arch/arm64/Kconfig"
osource "/home/bbspr/nrf-hci-iso/zephyrproject/zephyr/arch/arm/Kconfig"
osource "/home/bbspr/nrf-hci-iso/zephyrproject/zephyr/arch/arc/Kconfig"
```

## radxa-hci-iso/build/Kconfig/Kconfig.sysbuild.modules
```kconfig
config ZEPHYR_CMSIS_MODULE
   bool
   default y
config ZEPHYR_CMSIS_6_MODULE
   bool
   default y
config ZEPHYR_HAL_NORDIC_MODULE
   bool
   default y
config ZEPHYR_MBEDTLS_MODULE
   bool
   default y
config ZEPHYR_TF_PSA_CRYPTO_MODULE
   bool
   default y
```
